/*

wangguanfu
2009-08-06

*/

#include "ov7670.h"
#include "MyBspInc.h"
#include"VARIABLE.h"
static const u8 change_reg[CHANGE_REG_NUM][2]=
{
 /*  {0x12, 0x46},*/

	{0x3a, 0x04},
	{0x40, 0xd0},//0xd0->RGB565,0xF0->RGB555
	{0x12, 0x14},
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	{0x3b, 0xC2},//0x82,//0xc0,//0xc2,	//night mode
};

////////////////////////////
//功能：写OV7660寄存器
//返回：1-成功	0-失败
uchar wrOV7670Reg(uchar regID, uchar regDat)
{
	startSCCB();
	if(0==SCCBwriteByte(0x60))
	{
		stopSCCB();
		return(0);
	}
	//Delay_nUS(100);
  	if(0==SCCBwriteByte(regID))
	{
		stopSCCB();
		return(0);
	}
	//Delay_nUS(100);
  	if(0==SCCBwriteByte(regDat))
	{
		stopSCCB();
		return(0);
	}
  	stopSCCB();
	
  	return(1);
}
////////////////////////////
//功能：读OV7660寄存器
//返回：1-成功	0-失败
uchar rdOV7670Reg(uchar regID, uchar *regDat)
{
	//通过写操作设置寄存器地址
	startSCCB();
	if(0==SCCBwriteByte(0x60))
	{
		stopSCCB();
		return(0);
	}
	//Delay_nUS(100);
  	if(0==SCCBwriteByte(regID))
	{
		stopSCCB();
		return(0);
	}
	stopSCCB();
	
	//Delay_nUS(100);
	
	//设置寄存器地址后，才是读
	startSCCB();
	if(0==SCCBwriteByte(0x61))
	{
		stopSCCB();
		return(0);
	}
	//Delay_nUS(100);
  	*regDat=SCCBreadByte();
  	noAck();
  	stopSCCB();
  	return(1);
}


uchar temp;
/* OV7670_init() */
//返回1成功，返回0失败
uchar OV7670_init(void)
{
	
	
	uint i=0;

	
	InitSCCB();//io init..
	//OV2640_JpegInit(1);
	
	
	RCC->APB2ENR|=1<<4;//先使能外设PORTC时钟									 
	//PORTC0~13推挽输出 	
	GPIOC->CRL = 0x88888888;
	GPIOC->ODR |= 0x00FF;
	Exit_Init(GPIOB, GPIO_Pin_8, GPIO_Mode_IPU, EXTI_Trigger_Rising, 2, 3);	//VSYNC
	Exit_Init(GPIOB, GPIO_Pin_15, GPIO_Mode_IPU, EXTI_Trigger_Falling, 2, 4);//PICLK
	GpioInit(GPIOB, GPIO_Pin_14, GPIO_Mode_IPU, 0);							//HREF
	
	return;//从这里返回	
	

	temp=0x80;
	if(0==wrOV7670Reg(0x12, temp)) //Reset SCCB
	{
		return 0 ;
		
	}
	while(0)
	{
		rdOV7670Reg(0x1C, &temp);
		USART_Transmit(temp);
		Delay_nMS(100);
	}
	Delay_nMS(10);

	for(i=0;i<CHANGE_REG_NUM;i++)
	{
		if( 0 == wrOV7670Reg (change_reg[i][0],change_reg[i][1])   )
		{
			return 0;
		}
	}

	return 0x01; //ok

	
} 

